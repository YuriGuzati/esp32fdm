## main/Kconfig.projbuild
```kconfig
menu "ESP32 FDM Bridge Configuration"

    config WIFI_SSID
        string "WiFi SSID"
        default "myssid"
        help
            WiFi network name to connect to.

    config WIFI_PASSWORD
        string "WiFi Password"
        default "mypassword"
        help
            WiFi network password.

    config PRINTER_BAUD_RATE
        int "Default Printer Baud Rate"
        default 115200
        help
            Default baud rate for USB serial connection to the printer.

    config ESP32FDM_SIMULATION
        bool "Simulation mode (/obico/simulate) - DEVELOPMENT ONLY"
        default n
        help
            Shows fake printer data and DROPS every command sent to the printer,
            including cancel. Never enable this in a build used with a real printer.

    menu "Wi-Fi resilience"

        config WIFI_RECONNECT_MAX_BACKOFF_S
            int "Maximum delay between reconnect attempts (seconds)"
            default 60
            range 5 600
            help
                After the connection drops, the device retries forever with an
                exponential backoff (1 s, 2 s, 4 s ...) capped at this value.

        config WIFI_EMERGENCY_AP_MINUTES
            int "Emergency AP duration (minutes, 0 = disabled)"
            default 5
            range 0 60
            help
                If the saved network is unreachable at boot, the device keeps
                booting (camera, SD, USB, printer), keeps retrying the saved
                network and also opens its own access point for this many
                minutes (kept open while a client is connected).

    endmenu

    config BOOT_CONFIRM_DELAY_S
        int "Seconds of stable running before a new OTA image is confirmed"
        default 30
        range 5 600
        help
            With bootloader rollback enabled, a freshly updated image that
            crashes or is reset before this delay is rolled back to the
            previous image by the bootloader.

    menu "Obico Integration"

        config OBICO_SERVER_URL
            string "Obico Server URL"
            default "https://app.obico.io"
            help
                Obico server URL. Change for self-hosted instances.

        config OBICO_SNAP_INTERVAL_PRINTING
            int "Snapshot interval during printing (seconds)"
            default 10
            range 5 300
            help
                How often to upload JPEG snapshots while printing or when AI watching.

        config OBICO_SNAP_INTERVAL_IDLE
            int "Snapshot interval when idle (seconds)"
            default 120
            range 30 600
            help
                How often to upload JPEG snapshots when idle.

        config OBICO_STATUS_INTERVAL
            int "WebSocket status interval (seconds)"
            default 30
            range 10 120
            help
                How often to send printer status over WebSocket.

        config OBICO_JANUS_PROXY_HOST
            string "Janus proxy sidecar IP (empty = disabled)"
            default ""
            help
                IP address of the Linux sidecar running janus_proxy.
                Leave empty to disable WebRTC streaming relay.

        config OBICO_JANUS_PROXY_PORT
            int "Janus proxy sidecar port"
            default 17800
            range 1024 65535
            help
                TCP port for the Janus signaling relay connection to sidecar.

    endmenu

    menu "RFC 2217"

        config RFC2217_PORT
            int "RFC 2217 TCP Port"
            default 2217
            range 1 65535
            help
                TCP port for the RFC 2217 serial bridge server.

    endmenu

endmenu
```
